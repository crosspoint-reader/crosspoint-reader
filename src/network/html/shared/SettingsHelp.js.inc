// One-line explanations for the Settings page, in English: the setting names come from the
// reader in its own language, these do not. Written from USER_GUIDE.md and, where the guide says
// nothing, from the code. Keyed by the setting's JSON key; categories and sections by their English
// name, matched without regard to case. A setting missing here simply shows no explanation, so a new
// setting needs a line added here too.
const SETTINGS_HELP = {
  "categories": {
    "Display": "Sleep screen, themes, Home screen entries, screen refresh and the reading light.",
    "Reader": "Fonts, layout, spacing, images and reading aids for the books you read.",
    "Controls": "What each button press, touch gesture and tilt does.",
    "System": "How the Library lists files, beta updates and checking of secure connections.",
    "Clock": "The device clock: on or off, time format, time zone and time server.",
    "Weather": "The weather panel on the Home screen.",
    "KOReader Sync": "Keeps your reading position in step with KOReader and other devices through a sync server.",
    "Customise Status Bar": "What the status bar around the page shows while you read."
  },
  "sections": {
    "Sleep Screen": "What the screen shows while the device sleeps.",
    "User interface": "Look and text size of menus, lists and the Home screen.",
    "Home screen": "Entries switched off here move behind a More row on the Home screen.",
    "Screen refresh": "Full refreshes clear the ghosting e-paper builds up as pages turn.",
    "Reading light": "Devices with a frontlight or backlight only; brightness and warmth are set on the device.",
    "Reader Font": "Font and text rendering for EPUB books.",
    "TXT/MD Font": "Font for .txt and .md files, set separately from the EPUB font.",
    "Images": "How pictures inside books are shown.",
    "Button Actions": "Choose what a short, double or long press does; the first option is the button's usual job.",
    "Up Button": "The page-back key: Volume Up on the X3 and X4, Up on the X4 Pro; the T5 S3 has none.",
    "Down Button": "The page-forward key: Volume Down on the X3 and X4, Down on the X4 Pro and T5 S3.",
    "Touch Navigation": "Touch devices only: the X4 Pro and LilyGo T5 S3.",
    "Swipe": "Gestures on the reading page; Built-in leaves a gesture to the screen, Ignore switches it off.",
    "Tap": "The page has left and right columns; the middle column splits into top, centre and bottom.",
    "Long tap": "Hold a finger on a zone; the four corners answer only to a hold, on every screen.",
    "Tilt Page Turn": "X3 only: uses the built-in tilt sensor.",
    "Automatic Sync": "Background sync is X4 Pro and T5 S3 only; the X3 and X4 sync only on closing a book.",
    "Downloads": "Apply to books downloaded from every OPDS server."
  },
  "settings": {
    "sleepTimeoutMinutes": "Minutes without use before the device goes to sleep; 0 means never.",
    "sleepScreen": "What shows while the device sleeps; Custom uses your own images from the SD card, Cover the book's cover.",
    "edgeMargin": "Extra space at the screen edges, for cases that overlap the display, as on the LilyGo T5 S3.",
    "sleepScreenCoverMode": "For cover sleep screens: Fit shows the whole cover with white borders, Crop fills the screen.",
    "sleepScreenCoverFilter": "How a cover sleep screen is toned: grayscale (None), black & white, inverted, or contrast-boosted.",
    "sleepCoverOverlay": "Sleeping from a book adds a band with its title, author and progress in this colour.",
    "sleepImagePickMode": "Whether Custom sleep images are picked at random or shown in turn.",
    "quickResumeSleepScreen": "When the device sleeps on its own, the page stays on screen and waking returns straight to it.",
    "hideBatteryPercentage": "Hides the battery percentage: never, only while reading, or everywhere.",
    "uiTheme": "Look of menus and Home; Lyra Extended shows three books on Home, Lyra Carousel a cover carousel.",
    "uiFontSize": "Text size in menus, headers and lists; the reader's status bar is not affected.",
    "showLibraryOnHome": "Shows Library on the Home screen; when off, it moves behind More.",
    "showReadingStatsOnHome": "Shows Reading Stats on the Home screen; when off, it moves behind More.",
    "showBookmarksOnHome": "Shows Bookmarks on the Home screen once you have some; when off, they move behind More.",
    "showFileTransferOnHome": "Shows File Transfer on the Home screen; when off, it moves behind More.",
    "showWeatherOnHome": "Shows the weather panel on the Home screen; when off, it moves behind More.",
    "showBusyIndicator": "Shows an hourglass when a press starts a slow screen change, like opening a book. Not on the T5 S3.",
    "refreshFrequencyPages": "Pages between full refreshes, which clear ghosting from the screen; 0 means never.",
    "halfRefreshAfterImagePage": "Does an extra refresh after a page with pictures, to clear the shadow they leave.",
    "fadingFix": "Stops the page fading in direct sunlight on white X4 models.",
    "frontlightOn": "Switches the reading light on or off; brightness and warmth are set on the device.",
    "frontlightRestoreOnWake": "Whether waking turns the light back on; brightness and warmth are always remembered.",
    "orientation": "Which way round the page is shown: portrait, landscape either way, or upside down (Inverted).",
    "fontFamily": "Font for EPUB books: Bookerly, Noto Sans or a font installed on the SD card.",
    "fontSize": "Text size for EPUB books; the sizes offered depend on the font family chosen.",
    "textAntiAliasing": "Smooths the edges of text with grey; page turns get slightly slower.",
    "fastAntiAliasingV2": "Makes pages with smoothed text turn much faster; mid-greys come out slightly darker.",
    "textDarkness": "How dark text is drawn, from Lighter through Normal up to Maximum.",
    "txtFontFamily": "Font for .txt and .md files, chosen separately from the EPUB font.",
    "txtFontSize": "Text size for .txt and .md files; the sizes offered depend on the font chosen.",
    "paragraphAlignment": "How lines line up: justified, left, centred, right, or as the book sets them (Book's Style).",
    "embeddedStyle": "Follows the book's own formatting and styles; turn off to ignore them.",
    "hyphenationEnabled": "Splits long words at line ends with a hyphen, for more even spacing.",
    "fontSizeNormalization": "Shows text the book sets only slightly larger or smaller (within 10%) at your normal font size.",
    "imageRendering": "Show pictures in books, draw a box in their place (Placeholder), or leave them out (Suppress).",
    "largeImagePlaceholder": "Shows a placeholder in place of images too large to show in the page.",
    "screenMargin": "Space between the text and the left and right edges of the page, 5 to 40 px.",
    "lineSpacing": "Distance between lines of text; Tight fits more on a page.",
    "extraParagraphSpacing": "On adds space between paragraphs; off indents each paragraph's first line instead.",
    "syntheticTocFallback": "Builds a table of contents from the headings when a book's own is missing or broken.",
    "bionicReading": "Bolds the first half of each word to guide the eye.",
    "guideDots": "Draws a small dot in each space between words to guide the eye along the line.",
    "inlineFootnotePreviews": "Shows the start of each footnote in brackets right after its number in the text.",
    "btnShortBack": "A short Back press always leaves the book or goes back; it cannot be changed.",
    "btnDoubleBack": "Action for pressing Back twice quickly; setting one delays single presses slightly.",
    "btnLongBack": "Action for holding Back; by default it returns to the Home screen.",
    "btnShortConfirm": "A short Confirm press always opens the reader menu while reading; it cannot be changed.",
    "btnDoubleConfirm": "Action for pressing Confirm twice quickly; setting one delays single presses slightly.",
    "btnLongConfirm": "Action for holding Confirm; by default it compares your progress with the KOReader sync server.",
    "btnShortLeft": "Action for a short press of Left; by default the previous page while reading.",
    "btnDoubleLeft": "Action for pressing Left twice; by default skip 10 pages back. Ignore makes single presses quicker.",
    "btnLongLeft": "Action for holding Left; by default the previous chapter while reading.",
    "btnShortRight": "Action for a short press of Right; by default the next page while reading.",
    "btnDoubleRight": "Action for pressing Right twice; by default skip 10 pages forward. Ignore makes single presses quicker.",
    "btnLongRight": "Action for holding Right; by default the next chapter while reading.",
    "btnShortPageBack": "Action for a short press of Up; by default the previous page while reading.",
    "btnDoublePageBack": "Action for pressing Up twice quickly; setting one delays single presses slightly.",
    "btnLongPageBack": "Action for holding Up; by default the previous chapter while reading.",
    "btnShortPageForward": "Action for a short press of Down; by default the next page while reading.",
    "btnDoublePageForward": "Action for pressing Down twice quickly; setting one delays single presses slightly.",
    "btnLongPageForward": "Action for holding Down; by default the next chapter while reading.",
    "btnShortPower": "Action for a short press of Power, such as Sleep or Next Page; it does nothing by default.",
    "btnDoublePower": "Action for pressing Power twice quickly; toggles the reading light by default, where there is one.",
    "btnLongPower": "Holding Power always puts the device to sleep; it cannot be changed.",
    "touchUiControls": "Lets you use touch outside books: list rows, covers, the Home menu, settings tabs and button hints.",
    "touchListAct": "Whether the first tap on a list row only selects it (tap again to open) or opens it straight away.",
    "touchReaderCtl": "How touch turns pages: tap the left or right third, the same mirrored, swipe, or not at all.",
    "gestSwipeLeft": "Action for a leftward swipe; by default the next page in Swipe mode, otherwise nothing.",
    "gestSwipeRight": "Action for a rightward swipe; by default the previous page in Swipe mode, otherwise nothing.",
    "gestSwipeUpLeft": "Action for swiping up in the left edge column; by default the light gets brighter.",
    "gestSwipeUpRight": "Action for swiping up in the right edge column; by default the light gets warmer.",
    "gestSwipeDownLeft": "Action for swiping down in the left edge column; by default the light gets dimmer.",
    "gestSwipeDownRight": "Action for swiping down in the right edge column; by default the light gets cooler.",
    "gestSwipeInLeftZone": "Action for a sideways swipe in the left (back) column; by default skip 10 pages back.",
    "gestSwipeInRightZone": "Action for a sideways swipe in the right (forward) column; by default skip 10 pages forward.",
    "gestTapLeft": "Action for a tap in the left column; Built-in follows Touch Page Turn (previous page by default).",
    "gestTapRight": "Action for a tap in the right column; Built-in follows Touch Page Turn (next page by default).",
    "gestTapCentre": "Action for a tap in the centre of the page; by default it opens the reader menu.",
    "gestTapTop": "Action for a tap in the top zone of the middle column; it does nothing by default.",
    "gestTapBottom": "Action for a tap in the bottom zone of the middle column; it does nothing by default.",
    "gestLongTapLeft": "Action for holding a finger on the left column; by default the previous chapter.",
    "gestLongTapRight": "Action for holding a finger on the right column; by default the next chapter.",
    "gestLongTapCentre": "Action for holding a finger on the centre; by default it looks the word up in the dictionary.",
    "gestLongTapTop": "Action for holding a finger on the top zone; it does nothing by default.",
    "gestLongTapBottom": "Action for holding a finger on the bottom zone; by default it stars the page.",
    "gestLongTapTopLeft": "Action for holding the top-left corner, on any screen; by default it toggles the reading light.",
    "gestLongTapTopRight": "Action for holding the top-right corner, on any screen; free to assign.",
    "gestLongTapBottomLeft": "Action for holding the bottom-left corner, on any screen; free to assign.",
    "gestLongTapBottomRight": "Action for holding the bottom-right corner, on any screen; free to assign.",
    "gestPinchIn": "Action for pinching two fingers together; by default smaller text.",
    "gestPinchOut": "Action for spreading two fingers apart; by default larger text.",
    "gestRotateCw": "Action for turning two fingers clockwise; by default it changes the orientation forward.",
    "gestRotateCcw": "Action for turning two fingers anticlockwise; by default it changes the orientation back.",
    "tiltPageTurn": "Turns pages when you tilt the device to the left or right.",
    "tiltPositiveAction": "What tilting the device to the right does: nothing, next page or previous page.",
    "tiltNegativeAction": "What tilting the device to the left does: nothing, next page or previous page.",
    "showHiddenFiles": "Lists files and folders whose names start with a dot (.) in the Library, All Files and on the web.",
    "showFileExtensions": "Shows endings such as .epub after file names in the Library and All Files.",
    "fileBrowserView": "How the Library's Books tab shows books: by filename, with title and author (Details), or as covers.",
    "includeRcUpdates": "Also offers beta (release candidate) builds when checking for firmware updates.",
    "skipHttpsValidation": "Skips the certificate check on https servers, for self-hosted OPDS or sync servers; less safe.",
    "opdsDownloadFolder": "Folder on the SD card where downloaded books are saved; the top folder unless you change it.",
    "opdsFilenameFormat": "File name given to downloaded books, built from their author and title.",
    "useClock": "Shows the time in screen headers and allows a status bar clock; on the X4 it uses a little battery in sleep.",
    "clockFormat12h": "Shows times as 14:00 (24h) or 2:00pm (12h).",
    "clockTimezone": "Your time zone; named places follow their own daylight-saving rules, UTC offsets stay fixed.",
    "ntpServer": "Time server asked first when the clock syncs over WiFi; leave empty to use the built-in ones.",
    "useWeather": "Turns the weather feature on or off; off removes the weather panel from the Home screen and More.",
    "koServerUrl": "Address of the sync server; leave empty to use the free public server sync.koreader.rocks.",
    "koUsername": "Your sync account name; create one with Register in the device's KOReader Sync settings.",
    "koPassword": "Password for your sync account; once saved it is never shown here again.",
    "koMatchMethod": "How the server recognises a book: by file name, or by its contents (Binary; files must be identical).",
    "koSyncBehavior": "When this device and the server disagree: ask which position to keep, or use the one further on.",
    "koSendMetadata": "Sends the book's title, authors, ISBN and series with your position; only self-hosted servers use them.",
    "koSyncOnWake": "Fetches your reading position from the server when the device wakes.",
    "koPushIntervalPages": "Sends your position to the server every this many pages while you read; 0 means never.",
    "koSyncOnSleep": "Sends your position to the server when the device goes to sleep.",
    "koSyncOnBookClose": "Sends your position to the server when you close a book.",
    "koSyncMinSessionPages": "With On Closing a Book on, sends only after you turned at least this many pages; 0 sends every time.",
    "koShowSyncIndicator": "Shows a small mark in the reader's status bar while a background sync is running.",
    "statusBarUpperProgressBar": "A progress bar along the top of the page, for the whole book or the current chapter, or none.",
    "statusBarItemsPosition": "Whether the title, page numbers, battery and clock sit at the top or the bottom of the page.",
    "statusBarChapterPageCount": "Shows the page within the chapter and its total; a ~ before the total means it is still an estimate.",
    "statusBarPrintedPage": "Shows the printed edition's page number in brackets, for books that include one.",
    "statusBarBookProgressPercentage": "Shows how far through the whole book you are, in percent.",
    "statusBarTitle": "Shows the book's title or the current chapter's title, or nothing.",
    "statusBarBattery": "Shows the battery symbol in the reader's status bar.",
    "statusBarClock": "Shows the time in the reader's status bar; needs Use Clock turned on.",
    "statusBarClockPosition": "Puts the clock at the left or the right end of the status bar.",
    "statusBarLowerProgressBar": "A progress bar along the bottom of the page, for the whole book or the current chapter, or none."
  }
};
