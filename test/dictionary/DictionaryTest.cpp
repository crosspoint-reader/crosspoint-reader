// Host tests for the StarDict reader: DictionaryRegistry (folder discovery and
// path safety), the sidecar index build, lookup (exact / case / synonym / stem),
// and the dictzip random-access path.
//
// The fixture under test/fixtures/dictionary is generated by make_fixture.py in
// that directory; it holds two copies of the same dictionary, one with a plain
// .dict and one with a real dictzip .dict.dz, so the compressed path can be
// asserted against the uncompressed one rather than against hand-copied bytes.

#include <gtest/gtest.h>

#include <algorithm>
#include <cstdint>
#include <filesystem>
#include <fstream>
#include <string>
#include <vector>

#include "Dictionary.h"
#include "DictionaryRegistry.h"
#include "StringUtils.h"

namespace fs = std::filesystem;

namespace {

const fs::path kFixtureDir = DICT_FIXTURE_DIR;
const fs::path kSdRoot = DICT_TEST_ROOT;
const fs::path kDictRoot = kSdRoot / "dictionaries";
const fs::path kHiddenRoot = kSdRoot / ".dictionaries";

std::string readWholeFile(const fs::path& path) {
  std::ifstream in(path, std::ios::binary);
  return std::string((std::istreambuf_iterator<char>(in)), std::istreambuf_iterator<char>());
}

void writeWholeFile(const fs::path& path, const std::string& data) {
  fs::create_directories(path.parent_path());
  std::ofstream out(path, std::ios::binary | std::ios::trunc);
  out.write(data.data(), static_cast<std::streamsize>(data.size()));
}

uint32_t readBe32(const uint8_t* p) {
  return (static_cast<uint32_t>(p[0]) << 24) | (static_cast<uint32_t>(p[1]) << 16) |
         (static_cast<uint32_t>(p[2]) << 8) | static_cast<uint32_t>(p[3]);
}

// One .idx entry, as the test needs it to predict what a lookup must return.
struct IndexEntry {
  std::string word;
  uint32_t offset = 0;
  uint32_t size = 0;
};

// Parse a whole .idx. The test derives its expectations from the fixture rather
// than from constants copied alongside it, so regenerating the fixture with
// different words cannot silently stop testing anything.
std::vector<IndexEntry> parseIdx(const fs::path& path) {
  const std::string blob = readWholeFile(path);
  std::vector<IndexEntry> entries;
  size_t pos = 0;
  while (pos < blob.size()) {
    const size_t nul = blob.find('\0', pos);
    if (nul == std::string::npos || nul + 9 > blob.size()) break;
    IndexEntry e;
    e.word = blob.substr(pos, nul - pos);
    const auto* suffix = reinterpret_cast<const uint8_t*>(blob.data() + nul + 1);
    e.offset = readBe32(suffix);
    e.size = readBe32(suffix + 4);
    entries.push_back(std::move(e));
    pos = nul + 9;
  }
  return entries;
}

// Copy one generated dictionary into the SD root under a fresh folder name, so
// a test that writes sidecars or corrupts a file cannot disturb its neighbours.
// Returns the folder name to hand to Dictionary::open().
std::string provision(const std::string& fixtureFolder, const std::string& asFolder, bool hidden = false) {
  const fs::path dest = (hidden ? kHiddenRoot : kDictRoot) / asFolder;
  fs::remove_all(dest);
  fs::create_directories(dest);
  for (const auto& e : fs::directory_iterator(kFixtureDir / fixtureFolder)) {
    fs::copy_file(e.path(), dest / e.path().filename(), fs::copy_options::overwrite_existing);
  }
  return asFolder;
}

// A hand-built dictionary for the lookup-rule tests, which need headwords the
// generated fixture does not carry (case variants, umlauts, elisions).
struct HeadwordSpec {
  std::string word;
  std::string definition;
};
struct SynonymSpec {
  std::string word;
  std::string headword;  // must be one of the dictionary's headwords
};

// StarDict's own order: g_ascii_strcasecmp, ties broken by strcmp.
bool stardictLess(const std::string& a, const std::string& b) {
  const int c = StringUtils::asciiCaseCmp(a.c_str(), b.c_str());
  return c != 0 ? c < 0 : a < b;
}

void appendBe32(std::string& out, uint32_t v) {
  const char bytes[4] = {static_cast<char>(v >> 24), static_cast<char>(v >> 16), static_cast<char>(v >> 8),
                         static_cast<char>(v)};
  out.append(bytes, sizeof(bytes));
}

// Write an uncompressed dictionary (plus a .syn when synonyms are given) under
// /dictionaries/<folder>, both indexes sorted the way StarDict sorts them.
void writeDictionary(const std::string& folder, std::vector<HeadwordSpec> headwords,
                     std::vector<SynonymSpec> synonyms = {}) {
  std::sort(headwords.begin(), headwords.end(),
            [](const HeadwordSpec& a, const HeadwordSpec& b) { return stardictLess(a.word, b.word); });
  std::sort(synonyms.begin(), synonyms.end(),
            [](const SynonymSpec& a, const SynonymSpec& b) { return stardictLess(a.word, b.word); });
  std::string idx;
  std::string dict;
  for (const auto& h : headwords) {
    idx += h.word;
    idx += '\0';
    appendBe32(idx, static_cast<uint32_t>(dict.size()));
    appendBe32(idx, static_cast<uint32_t>(h.definition.size()));
    dict += h.definition;
  }
  std::string syn;
  for (const auto& s : synonyms) {
    const auto it =
        std::find_if(headwords.begin(), headwords.end(), [&s](const HeadwordSpec& h) { return h.word == s.headword; });
    ASSERT_NE(it, headwords.end()) << "synonym " << s.word << " names no headword";
    syn += s.word;
    syn += '\0';
    appendBe32(syn, static_cast<uint32_t>(it - headwords.begin()));
  }
  const fs::path dir = kDictRoot / folder;
  fs::remove_all(dir);
  writeWholeFile(dir / "words.idx", idx);
  writeWholeFile(dir / "words.dict", dict);
  writeWholeFile(dir / "words.ifo", "StarDict's dict ifo file\nsametypesequence=m\n");
  if (!syn.empty()) writeWholeFile(dir / "words.syn", syn);
}

// open() + buildIndex(), the sequence every caller runs before a first lookup.
void openIndexed(Dictionary& dict, const std::string& folder) {
  ASSERT_TRUE(dict.open(folder.c_str())) << folder;
  Dictionary::IndexResult indexResult = Dictionary::IndexResult::ReadError;
  ASSERT_TRUE(dict.buildIndex(nullptr, nullptr, &indexResult));
  ASSERT_EQ(indexResult, Dictionary::IndexResult::Ok);
}

class DictionaryTest : public ::testing::Test {
 protected:
  static void SetUpTestSuite() {
    fs::remove_all(kSdRoot);
    fs::create_directories(kDictRoot);
    fs::create_directories(kHiddenRoot);
    plainEntries = parseIdx(kFixtureDir / "plain" / "plain.idx");
    plainDictBlob = readWholeFile(kFixtureDir / "plain" / "plain.dict");
    ASSERT_FALSE(plainEntries.empty());
    ASSERT_FALSE(plainDictBlob.empty());
  }

  // The definition text the index says belongs to `word`, straight out of the
  // uncompressed fixture .dict.
  static std::string expectedDefinition(const std::string& word) {
    for (const auto& e : plainEntries) {
      if (e.word == word) return plainDictBlob.substr(e.offset, e.size);
    }
    ADD_FAILURE() << "fixture has no headword " << word;
    return {};
  }

  static std::vector<IndexEntry> plainEntries;
  static std::string plainDictBlob;
};

std::vector<IndexEntry> DictionaryTest::plainEntries;
std::string DictionaryTest::plainDictBlob;

// --- registry ---------------------------------------------------------------

TEST_F(DictionaryTest, DiscoverFindsBothRootsAndSkipsUnusableFolders) {
  provision("plain", "Alpha");
  provision("zipped", "Beta");
  provision("plain", "HiddenOne", /*hidden=*/true);

  // Index but no data: unusable, and surfacing it would mean a dictionary that
  // fails only once the user looks a word up.
  writeWholeFile(kDictRoot / "NoData" / "nodata.idx", "x");
  // Two distinct stems: which one is "the" dictionary is undecidable.
  writeWholeFile(kDictRoot / "Ambiguous" / "one.idx", "x");
  writeWholeFile(kDictRoot / "Ambiguous" / "one.dict", "x");
  writeWholeFile(kDictRoot / "Ambiguous" / "two.idx", "x");
  // macOS AppleDouble sidecar next to a real index must not count as a stem.
  provision("plain", "Gamma");
  writeWholeFile(kDictRoot / "Gamma" / "._plain.idx", "x");
  // A dot-folder is hidden from the browser and skipped by the scan.
  writeWholeFile(kDictRoot / ".Skipped" / "s.idx", "x");
  writeWholeFile(kDictRoot / ".Skipped" / "s.dict", "x");

  std::vector<DictionaryEntry> found;
  DictionaryRegistry::discover(found);

  std::vector<std::string> names;
  for (const auto& e : found) names.push_back(e.name);
  EXPECT_EQ(names, (std::vector<std::string>{"Alpha", "Beta", "Gamma", "HiddenOne"}));
  ASSERT_FALSE(found.empty());
  EXPECT_EQ(found[0].stem, "plain");
  EXPECT_EQ(found[1].stem, "zipped");
}

TEST_F(DictionaryTest, ResolveBasePathRejectsEscapesAndMissingFolders) {
  provision("plain", "Alpha");
  std::string base;
  EXPECT_TRUE(DictionaryRegistry::resolveBasePath("Alpha", base));
  // generic_string(), not string(): resolveBasePath() joins with '/' on every
  // platform because it builds SD/FAT paths, but fs::path::operator/ inserts
  // the host's preferred separator, which is '\' on Windows. string() would
  // therefore expect "sdroot\dictionaries\Alpha\plain" and fail there while
  // passing on Linux. generic_string() always renders '/', so the expectation
  // matches what the firmware actually produces.
  EXPECT_EQ(base, (kDictRoot / "Alpha" / "plain").generic_string());

  // The folder name comes out of the settings JSON, so a crafted value must not
  // be able to walk out of the dictionary roots.
  EXPECT_FALSE(DictionaryRegistry::resolveBasePath("../secrets", base));
  EXPECT_FALSE(DictionaryRegistry::resolveBasePath("Alpha/plain", base));
  EXPECT_FALSE(DictionaryRegistry::resolveBasePath("..", base));
  EXPECT_FALSE(DictionaryRegistry::resolveBasePath(".hidden", base));
  EXPECT_FALSE(DictionaryRegistry::resolveBasePath("", base));
  EXPECT_FALSE(DictionaryRegistry::resolveBasePath(nullptr, base));
  EXPECT_FALSE(DictionaryRegistry::resolveBasePath("NoSuchFolder", base));
}

// --- open / .ifo ------------------------------------------------------------

TEST_F(DictionaryTest, OpenRejectsSixtyFourBitOffsets) {
  const std::string folder = provision("plain", "Wide");
  const fs::path ifo = kDictRoot / folder / "plain.ifo";
  writeWholeFile(ifo, readWholeFile(ifo) + "idxoffsetbits=64\n");

  Dictionary dict;
  EXPECT_FALSE(dict.open(folder.c_str()));
  EXPECT_FALSE(dict.isOpen());
}

TEST_F(DictionaryTest, HtmlDefinitionsFollowSametypesequence) {
  const std::string plainFolder = provision("plain", "PlainTypes");
  Dictionary plain;
  ASSERT_TRUE(plain.open(plainFolder.c_str()));
  EXPECT_FALSE(plain.definitionsAreHtml());

  const std::string htmlFolder = provision("plain", "HtmlTypes");
  const fs::path ifo = kDictRoot / htmlFolder / "plain.ifo";
  std::string text = readWholeFile(ifo);
  const size_t at = text.find("sametypesequence=m");
  ASSERT_NE(at, std::string::npos);
  text.replace(at, std::string("sametypesequence=m").size(), "sametypesequence=h");
  writeWholeFile(ifo, text);

  Dictionary html;
  ASSERT_TRUE(html.open(htmlFolder.c_str()));
  EXPECT_TRUE(html.definitionsAreHtml());
}

TEST_F(DictionaryTest, OpenFailsWithoutDictData) {
  fs::remove_all(kDictRoot / "IndexOnly");
  writeWholeFile(kDictRoot / "IndexOnly" / "x.idx", std::string("word", 4) + std::string(9, '\0'));
  Dictionary dict;
  EXPECT_FALSE(dict.open("IndexOnly"));
}

// --- index build ------------------------------------------------------------

TEST_F(DictionaryTest, BuildIndexWritesSidecarsAndIsIdempotent) {
  const std::string folder = provision("plain", "Indexing");
  const fs::path qidx = kDictRoot / folder / "plain.qidx";
  const fs::path sidx = kDictRoot / folder / "plain.sidx";

  Dictionary dict;
  ASSERT_TRUE(dict.open(folder.c_str()));
  EXPECT_TRUE(dict.needsIndex());
  EXPECT_FALSE(fs::exists(qidx));

  ASSERT_TRUE(dict.buildIndex());
  EXPECT_TRUE(fs::exists(qidx));
  EXPECT_TRUE(fs::exists(sidx));
  EXPECT_FALSE(dict.needsIndex());

  // A second pass must not rewrite a fresh sidecar -- the .idx scan is the slow
  // first-use cost the sidecar exists to pay only once.
  const auto qidxWritten = fs::last_write_time(qidx);
  const std::string before = readWholeFile(qidx);
  ASSERT_TRUE(dict.buildIndex());
  EXPECT_EQ(fs::last_write_time(qidx), qidxWritten);
  EXPECT_EQ(readWholeFile(qidx), before);
}

TEST_F(DictionaryTest, SidecarIsRebuiltWhenTheIndexChangesSize) {
  const std::string folder = provision("plain", "Restale");
  Dictionary dict;
  ASSERT_NO_FATAL_FAILURE(openIndexed(dict, folder));
  EXPECT_FALSE(dict.needsIndex());

  const fs::path idx = kDictRoot / folder / "plain.idx";
  writeWholeFile(idx, readWholeFile(idx) + std::string(9, '\0'));

  Dictionary reopened;
  ASSERT_TRUE(reopened.open(folder.c_str()));
  EXPECT_TRUE(reopened.needsIndex());
}

// --- lookup -----------------------------------------------------------------

TEST_F(DictionaryTest, ExactLookupsAcrossTheWholeIndex) {
  const std::string folder = provision("plain", "Exact");
  Dictionary dict;
  ASSERT_NO_FATAL_FAILURE(openIndexed(dict, folder));

  // First, last and a spread of interior entries: the interior ones are what
  // force a real descent through the sampled sidecar.
  std::vector<size_t> probes = {0, 1, plainEntries.size() / 2, plainEntries.size() - 1};
  for (size_t i = 0; i < plainEntries.size(); i += 137) probes.push_back(i);

  for (size_t i : probes) {
    const IndexEntry& entry = plainEntries[i];
    std::string definition;
    std::string headword;
    Dictionary::LookupResult result = Dictionary::LookupResult::NotFound;
    ASSERT_TRUE(dict.lookup(entry.word.c_str(), definition, headword, &result))
        << "entry " << i << " (" << entry.word << ")";
    EXPECT_EQ(result, Dictionary::LookupResult::Found);
    EXPECT_EQ(headword, entry.word);
    EXPECT_EQ(definition, plainDictBlob.substr(entry.offset, entry.size));
  }
}

TEST_F(DictionaryTest, LookupIsCaseInsensitive) {
  const std::string folder = provision("plain", "Casing");
  Dictionary dict;
  ASSERT_NO_FATAL_FAILURE(openIndexed(dict, folder));

  std::string definition;
  std::string headword;
  ASSERT_TRUE(dict.lookup("QUIXOTIC", definition, headword));
  EXPECT_EQ(headword, "quixotic");
  EXPECT_EQ(definition, expectedDefinition("quixotic"));

  // A capitalised headword found through a lowercase query -- the case that
  // plain strcmp ordering would put on the wrong page of the index.
  definition.clear();
  ASSERT_TRUE(dict.lookup("quorum", definition, headword));
  EXPECT_EQ(headword, "Quorum");
  EXPECT_EQ(definition, expectedDefinition("Quorum"));
}

TEST_F(DictionaryTest, MissReportsNotFoundRatherThanAFailure) {
  const std::string folder = provision("plain", "Missing");
  Dictionary dict;
  ASSERT_NO_FATAL_FAILURE(openIndexed(dict, folder));

  std::string definition;
  std::string headword;
  Dictionary::LookupResult result = Dictionary::LookupResult::Found;
  EXPECT_FALSE(dict.lookup("zzzzzzzznotaword", definition, headword, &result));
  EXPECT_EQ(result, Dictionary::LookupResult::NotFound);

  // Before the first entry and after the last: the two ends the descent has to
  // clamp rather than run off.
  EXPECT_FALSE(dict.lookup("AAAAAAAA", definition, headword, &result));
  EXPECT_EQ(result, Dictionary::LookupResult::NotFound);
  EXPECT_FALSE(dict.lookup("zzzzzzzz", definition, headword, &result));
  EXPECT_EQ(result, Dictionary::LookupResult::NotFound);
}

TEST_F(DictionaryTest, StemVariantsResolveToTheirHeadword) {
  const std::string folder = provision("plain", "Stemming");
  Dictionary dict;
  ASSERT_NO_FATAL_FAILURE(openIndexed(dict, folder));

  // Every stem probe after the first reuses the sample window the exact-match
  // probe resolved, so run enough of them, spread across the index, to catch a
  // window that is reused when it should not be.
  int checked = 0;
  for (size_t i = 0; i < plainEntries.size(); i += 53) {
    const std::string& word = plainEntries[i].word;
    const std::string inflected = word + "s";
    // Skip if the inflected form is itself a headword: then it is an exact hit
    // and proves nothing about stemming.
    bool inflectedIsHeadword = false;
    for (const auto& e : plainEntries) {
      if (e.word == inflected) inflectedIsHeadword = true;
    }
    if (inflectedIsHeadword) continue;

    std::string definition;
    std::string headword;
    ASSERT_TRUE(dict.lookup(inflected.c_str(), definition, headword)) << inflected;
    EXPECT_EQ(headword, word);
    EXPECT_EQ(definition, plainDictBlob.substr(plainEntries[i].offset, plainEntries[i].size));
    checked++;
  }
  EXPECT_GT(checked, 20);
}

TEST_F(DictionaryTest, HyphenatedCompoundsFallBackToTheirLongestPart) {
  const std::string folder = provision("plain", "Hyphenated");
  Dictionary dict;
  ASSERT_NO_FATAL_FAILURE(openIndexed(dict, folder));

  std::string definition;
  std::string headword;

  // A compound that IS a headword must win outright -- it must not be split and
  // resolved to "being", which would return the wrong entry for a word the
  // dictionary actually has.
  ASSERT_TRUE(dict.lookup("well-being", definition, headword));
  EXPECT_EQ(headword, "well-being");
  EXPECT_EQ(definition, expectedDefinition("well-being"));

  // A compound that is not a headword falls back to its longest part, which is
  // the one carrying the meaning.
  ASSERT_TRUE(dict.lookup("multi-billionaire", definition, headword));
  EXPECT_EQ(headword, "billionaire");
  EXPECT_EQ(definition, expectedDefinition("billionaire"));

  // Longest-first, not head-final: "law" would be the head here and is not in
  // the dictionary, while "mother" is what the reader wants.
  ASSERT_TRUE(dict.lookup("mother-in-law", definition, headword));
  EXPECT_EQ(headword, "mother");

  // The real hyphens EPUB text uses, not just ASCII.
  ASSERT_TRUE(
      dict.lookup("multi\xE2\x80\x91"
                  "billionaire",
                  definition, headword));
  EXPECT_EQ(headword, "billionaire");

  // Surrounding punctuation and case still get cleaned off first.
  ASSERT_TRUE(dict.lookup("(Multi-Billionaire)", definition, headword));
  EXPECT_EQ(headword, "billionaire");

  // A compound whose parts are all absent is still a genuine miss.
  Dictionary::LookupResult result = Dictionary::LookupResult::Found;
  EXPECT_FALSE(dict.lookup("zzzznope-yyyynope", definition, headword, &result));
  EXPECT_EQ(result, Dictionary::LookupResult::NotFound);
}

TEST_F(DictionaryTest, SynonymsResolveThroughTheOrdinalIndex) {
  const std::string folder = provision("plain", "Synonyms");
  Dictionary dict;
  ASSERT_NO_FATAL_FAILURE(openIndexed(dict, folder));

  // "quixotical" is in the .syn only: no stemming rule turns it into
  // "quixotic", so a hit here can only have come through the synonym index and
  // its ordinal -> headword resolution.
  std::string definition;
  std::string headword;
  Dictionary::LookupResult result = Dictionary::LookupResult::NotFound;
  ASSERT_TRUE(dict.lookup("quixotical", definition, headword, &result));
  EXPECT_EQ(result, Dictionary::LookupResult::Found);
  EXPECT_EQ(headword, "quixotic");
  EXPECT_EQ(definition, expectedDefinition("quixotic"));
}

TEST_F(DictionaryTest, ExactCaseHeadwordWinsOverItsCapitalisedVariants) {
  // StarDict sorts case variants capitals first, so a scan that took the first
  // case-insensitive match answered "husk" with the surname.
  ASSERT_NO_FATAL_FAILURE(writeDictionary("CaseRun",
                                          {{"HUSK", "an acronym"},
                                           {"Husk", "a surname"},
                                           {"husk", "the dry outer covering"},
                                           {"Matter", "a surname"},
                                           {"matter", "substance"},
                                           {"Paris", "the capital of France"}},
                                          {{"Husks", "Husk"}, {"husks", "husk"}}));
  Dictionary dict;
  ASSERT_NO_FATAL_FAILURE(openIndexed(dict, "CaseRun"));

  std::string definition;
  std::string headword;
  ASSERT_TRUE(dict.lookup("husk", definition, headword));
  EXPECT_EQ(headword, "husk");
  EXPECT_EQ(definition, "the dry outer covering");
  ASSERT_TRUE(dict.lookup("matter", definition, headword));
  EXPECT_EQ(headword, "matter");
  EXPECT_EQ(definition, "substance");

  // A sentence-initial capital is cleaned away, so it gets the common word too.
  ASSERT_TRUE(dict.lookup("Husk", definition, headword));
  EXPECT_EQ(headword, "husk");

  // A word the dictionary only has capitalised is still found.
  ASSERT_TRUE(dict.lookup("paris", definition, headword));
  EXPECT_EQ(headword, "Paris");
  EXPECT_EQ(definition, "the capital of France");

  // The .syn has the same runs and takes the same rule.
  ASSERT_TRUE(dict.lookup("husks", definition, headword));
  EXPECT_EQ(headword, "husk");
  EXPECT_EQ(definition, "the dry outer covering");
}

TEST_F(DictionaryTest, ExactCaseHeadwordIsFoundWhenItsRunStraddlesASample) {
  // The sidecar samples every 256th entry. Slide a three-entry case run across
  // that boundary so the descent lands before, inside and at the end of it.
  for (int fillers = 253; fillers <= 257; fillers++) {
    std::vector<HeadwordSpec> headwords;
    for (int i = 0; i < fillers; i++) {
      char word[16];
      snprintf(word, sizeof(word), "aaa%03d", i);
      headwords.push_back({word, "filler"});
    }
    headwords.push_back({"HUSK", "an acronym"});
    headwords.push_back({"Husk", "a surname"});
    headwords.push_back({"husk", "the dry outer covering"});
    headwords.push_back({"zebra", "the striped one"});
    const std::string folder = "Straddle" + std::to_string(fillers);
    ASSERT_NO_FATAL_FAILURE(writeDictionary(folder, headwords));
    Dictionary dict;
    ASSERT_NO_FATAL_FAILURE(openIndexed(dict, folder));

    std::string definition;
    std::string headword;
    ASSERT_TRUE(dict.lookup("husk", definition, headword)) << fillers;
    EXPECT_EQ(headword, "husk") << fillers;
    EXPECT_EQ(definition, "the dry outer covering") << fillers;
  }
}

// Asserts that `word` resolves to `headword` and reads back `definition`.
void expectHit(Dictionary& dict, const char* word, const char* headword, const char* definition) {
  std::string gotDefinition;
  std::string gotHeadword;
  ASSERT_TRUE(dict.lookup(word, gotDefinition, gotHeadword)) << word;
  EXPECT_EQ(gotHeadword, headword) << word;
  EXPECT_EQ(gotDefinition, definition) << word;
}

TEST_F(DictionaryTest, CapitalisedNonAsciiWordsFindTheirLowercaseHeadword) {
  ASSERT_NO_FATAL_FAILURE(writeDictionary("Folded", {{"über", "over"},
                                                     {"straße", "street"},
                                                     {"привет", "hello"},
                                                     {"γεια", "hi"},
                                                     {"τους", "them"},
                                                     {"їжак", "hedgehog"},
                                                     {"Ärzte", "doctors"},
                                                     {"ärzte", "a lowercase decoy"},
                                                     {"Москва", "Moscow"}}));
  Dictionary dict;
  ASSERT_NO_FATAL_FAILURE(openIndexed(dict, "Folded"));

  // Sentence-initial and all-caps forms: cleanWord() lowercases only ASCII.
  expectHit(dict, "Über", "über", "over");
  expectHit(dict, "ÜBER", "über", "over");
  expectHit(dict, "STRAẞE", "straße", "street");
  expectHit(dict, "Привет", "привет", "hello");
  expectHit(dict, "ПРИВЕТ", "привет", "hello");
  expectHit(dict, "Γεια", "γεια", "hi");
  expectHit(dict, "ΤΟΥΣ", "τους", "them");  // a word-final sigma lowercases to ς
  expectHit(dict, "Їжак", "їжак", "hedgehog");

  // A headword stored capitalised keeps its exact hit: the lowercase form is
  // only the fallback, so the decoy is never reached.
  expectHit(dict, "Ärzte", "Ärzte", "doctors");
  expectHit(dict, "Москва", "Москва", "Moscow");
}

TEST_F(DictionaryTest, FrenchElisionsFallBackToTheWordAfterTheApostrophe) {
  ASSERT_NO_FATAL_FAILURE(writeDictionary("Elisions", {{"histoire", "story"},
                                                       {"après", "after"},
                                                       {"aime", "loves"},
                                                       {"est", "is"},
                                                       {"été", "summer"},
                                                       {"avant", "before"},
                                                       {"arc-en-ciel", "rainbow"},
                                                       {"d'accord", "agreed"},
                                                       {"accord", "a decoy"},
                                                       {"aujourd'hui", "today"},
                                                       {"brien", "a decoy"}}));
  Dictionary dict;
  ASSERT_NO_FATAL_FAILURE(openIndexed(dict, "Elisions"));

  expectHit(dict, "l'histoire", "histoire", "story");
  expectHit(dict, "l’histoire", "histoire", "story");
  expectHit(dict, "L’Histoire", "histoire", "story");
  expectHit(dict, "qu'après", "après", "after");
  expectHit(dict, "QU’Après", "après", "after");  // and the remainder is lowercased as a fallback
  expectHit(dict, "Lʼété", "été", "summer");      // U+02BC modifier apostrophe
  expectHit(dict, "j'aime", "aime", "loves");
  expectHit(dict, "n’aime", "aime", "loves");
  expectHit(dict, "c’est", "est", "is");
  // The remainder gets the whole probe, stems included, and its hyphen parts.
  expectHit(dict, "d'histoires", "histoire", "story");
  expectHit(dict, "l'arc-en-ciel", "arc-en-ciel", "rainbow");
  expectHit(dict, "d'avant-garde", "avant", "before");  // split from "avant-garde", not "d'avant-garde"

  // A headword that is itself elided wins over its remainder.
  expectHit(dict, "d'accord", "d'accord", "agreed");
  expectHit(dict, "aujourd'hui", "aujourd'hui", "today");

  // Only the French prefixes are stripped, and never down to nothing.
  std::string definition;
  std::string headword;
  Dictionary::LookupResult result = Dictionary::LookupResult::Found;
  EXPECT_FALSE(dict.lookup("O'Brien", definition, headword, &result));
  EXPECT_EQ(result, Dictionary::LookupResult::NotFound);
  EXPECT_FALSE(dict.lookup("l'", definition, headword, &result));
  EXPECT_EQ(result, Dictionary::LookupResult::NotFound);
}

TEST_F(DictionaryTest, ResolveFindsTheLocationWithoutReadingIt) {
  const std::string folder = provision("plain", "Resolving");
  Dictionary dict;
  ASSERT_NO_FATAL_FAILURE(openIndexed(dict, folder));

  // resolve() must agree with the index on both the location and the headword,
  // for exact hits, stemmed hits and synonyms alike -- it is the same search.
  for (size_t i = 0; i < plainEntries.size(); i += 211) {
    const IndexEntry& entry = plainEntries[i];
    DictLocation location;
    std::string headword;
    Dictionary::LookupResult result = Dictionary::LookupResult::NotFound;
    ASSERT_TRUE(dict.resolve(entry.word.c_str(), location, headword, &result)) << entry.word;
    EXPECT_EQ(result, Dictionary::LookupResult::Found);
    EXPECT_TRUE(location.found);
    EXPECT_EQ(location.offset, entry.offset);
    EXPECT_EQ(location.size, entry.size);
    EXPECT_EQ(headword, entry.word);

    // And reading that location gives exactly what lookup() would have.
    std::string definition;
    ASSERT_TRUE(dict.readResolved(location, definition, &result));
    EXPECT_EQ(result, Dictionary::LookupResult::Found);
    EXPECT_EQ(definition, plainDictBlob.substr(entry.offset, entry.size));
  }

  DictLocation synonymLocation;
  std::string synonymHeadword;
  ASSERT_TRUE(dict.resolve("quixotical", synonymLocation, synonymHeadword));
  EXPECT_EQ(synonymHeadword, "quixotic");

  // A miss resolves to nothing and reports a miss, not a failure.
  DictLocation missLocation;
  std::string missHeadword;
  Dictionary::LookupResult missResult = Dictionary::LookupResult::Found;
  EXPECT_FALSE(dict.resolve("zzzzzzzznotaword", missLocation, missHeadword, &missResult));
  EXPECT_EQ(missResult, Dictionary::LookupResult::NotFound);
  EXPECT_FALSE(missLocation.found);
}

TEST_F(DictionaryTest, LookupsSucceedWithoutTheSidecar) {
  // No .qidx: locate() must fall back to scanning the index from byte 0 rather
  // than fail, because a dictionary can be used before the indexing pass runs.
  const std::string folder = provision("plain", "Unindexed");
  Dictionary dict;
  ASSERT_TRUE(dict.open(folder.c_str()));
  ASSERT_TRUE(dict.needsIndex());

  std::string definition;
  std::string headword;
  ASSERT_TRUE(dict.lookup("quixotic", definition, headword));
  EXPECT_EQ(definition, expectedDefinition("quixotic"));
}

TEST_F(DictionaryTest, ReleaseCachesLeavesTheDictionaryUsable) {
  const std::string folder = provision("plain", "Recycled");
  Dictionary dict;
  ASSERT_NO_FATAL_FAILURE(openIndexed(dict, folder));

  std::string definition;
  std::string headword;
  ASSERT_TRUE(dict.lookup("quixotic", definition, headword));
  dict.releaseCaches();
  // The session buffers are gone; the next lookup has to take them again.
  definition.clear();
  ASSERT_TRUE(dict.lookup("quixotic", definition, headword));
  EXPECT_EQ(definition, expectedDefinition("quixotic"));
}

// --- dictzip ----------------------------------------------------------------

TEST_F(DictionaryTest, CompressedDictionaryMatchesThePlainOneByteForByte) {
  const std::string folder = provision("zipped", "Zipped");
  Dictionary dict;
  ASSERT_NO_FATAL_FAILURE(openIndexed(dict, folder));

  // Spread the probes so definitions land at chunk starts, chunk middles and
  // across chunk boundaries.
  for (size_t i = 0; i < plainEntries.size(); i += 29) {
    const IndexEntry& entry = plainEntries[i];
    std::string definition;
    std::string headword;
    ASSERT_TRUE(dict.lookup(entry.word.c_str(), definition, headword)) << entry.word;
    EXPECT_EQ(definition, plainDictBlob.substr(entry.offset, entry.size)) << entry.word;
  }
}

TEST_F(DictionaryTest, MultiChunkDefinitionIsReassembledInOrder) {
  const std::string folder = provision("zipped", "ZippedLong");
  Dictionary dict;
  ASSERT_NO_FATAL_FAILURE(openIndexed(dict, folder));

  const std::string expected = expectedDefinition("longword");
  // The fixture's chunk length is 4096, so this definition must span several
  // chunks -- otherwise the test is not exercising the chunk loop at all.
  ASSERT_GT(expected.size(), 4096u * 3);

  std::string definition;
  std::string headword;
  ASSERT_TRUE(dict.lookup("longword", definition, headword));
  EXPECT_EQ(definition, expected);
}

TEST_F(DictionaryTest, CorruptCompressedDataFailsWithoutClaimingAMiss) {
  const std::string folder = provision("zipped", "ZippedCorrupt");
  Dictionary dict;
  ASSERT_NO_FATAL_FAILURE(openIndexed(dict, folder));

  // Truncate the compressed data, leaving the header and its chunk table intact.
  // The last headword's bytes live in the final chunk, so its compressed data is
  // certainly gone. The index still says the entry is there, so a failure here
  // must be named as a failure, not reported as "not found".
  const fs::path dz = kDictRoot / folder / "zipped.dict.dz";
  std::string blob = readWholeFile(dz);
  blob.resize(blob.size() / 2);
  writeWholeFile(dz, blob);

  const std::string& lastWord = plainEntries.back().word;
  std::string definition;
  std::string headword;
  Dictionary::LookupResult result = Dictionary::LookupResult::Found;
  EXPECT_FALSE(dict.lookup(lastWord.c_str(), definition, headword, &result));
  EXPECT_TRUE(result == Dictionary::LookupResult::ReadError || result == Dictionary::LookupResult::Decompress)
      << "unexpected result " << static_cast<int>(result);
}

// --- index scanning edge cases ---------------------------------------------

TEST_F(DictionaryTest, OverlongHeadwordDoesNotDesynchroniseTheScan) {
  // A headword longer than the reader's word buffer is truncated, but the entry
  // after it must still be found: the scan has to skip the rest of the word and
  // its 8 suffix bytes exactly.
  const std::string giant(600, 'm');
  const std::string tail = "zebra";
  const std::string body = "the striped one";

  std::string idx;
  const auto appendEntry = [&idx](const std::string& word, uint32_t offset, uint32_t size) {
    idx += word;
    idx += '\0';
    const uint8_t suffix[8] = {static_cast<uint8_t>(offset >> 24), static_cast<uint8_t>(offset >> 16),
                               static_cast<uint8_t>(offset >> 8),  static_cast<uint8_t>(offset),
                               static_cast<uint8_t>(size >> 24),   static_cast<uint8_t>(size >> 16),
                               static_cast<uint8_t>(size >> 8),    static_cast<uint8_t>(size)};
    idx.append(reinterpret_cast<const char*>(suffix), sizeof(suffix));
  };
  appendEntry(giant, 0, 5);
  appendEntry(tail, 5, static_cast<uint32_t>(body.size()));

  fs::remove_all(kDictRoot / "Overlong");
  writeWholeFile(kDictRoot / "Overlong" / "big.idx", idx);
  writeWholeFile(kDictRoot / "Overlong" / "big.dict", "GIANT" + body);
  writeWholeFile(kDictRoot / "Overlong" / "big.ifo", "StarDict's dict ifo file\nsametypesequence=m\n");

  Dictionary dict;
  ASSERT_NO_FATAL_FAILURE(openIndexed(dict, "Overlong"));

  std::string definition;
  std::string headword;
  ASSERT_TRUE(dict.lookup(tail.c_str(), definition, headword));
  EXPECT_EQ(headword, tail);
  EXPECT_EQ(definition, body);
}

// --- cleanWord --------------------------------------------------------------

TEST_F(DictionaryTest, CleanWordStripsPunctuationAndFoldsCase) {
  EXPECT_EQ(Dictionary::cleanWord("Garage"), "garage");
  EXPECT_EQ(Dictionary::cleanWord("\"quoted,\""), "quoted");
  EXPECT_EQ(Dictionary::cleanWord("(parens)"), "parens");
  // Curly quotes and dashes are >= 0x80, so they survive the ASCII punctuation
  // test and have to be stripped as whole codepoints.
  EXPECT_EQ(Dictionary::cleanWord("garage."
                                  "\xE2\x80\x9D"),
            "garage");
  EXPECT_EQ(Dictionary::cleanWord("\xE2\x80\x9C"
                                  "garage"
                                  "\xE2\x80\x9D"),
            "garage");
  EXPECT_EQ(Dictionary::cleanWord("\xE2\x80\x94"
                                  "dash"),
            "dash");
  // Accented letters are word bytes and must be preserved untouched.
  EXPECT_EQ(Dictionary::cleanWord("Caf"
                                  "\xC3\xA9"
                                  ","),
            "caf"
            "\xC3\xA9");
  EXPECT_EQ(Dictionary::cleanWord("...."), "");
  EXPECT_EQ(Dictionary::cleanWord(""), "");
  EXPECT_EQ(Dictionary::cleanWord(nullptr), "");
}

TEST_F(DictionaryTest, CleanWordStripsNonAsciiPunctuation) {
  // Outside General Punctuation, every byte >= 0x80 used to count as a letter.
  EXPECT_EQ(Dictionary::cleanWord("«Über»"), "Über");  // non-ASCII case is resolve()'s job
  EXPECT_EQ(Dictionary::cleanWord("« mot »"), "mot");
  EXPECT_EQ(Dictionary::cleanWord("¿Qué?"), "qué");
  EXPECT_EQ(Dictionary::cleanWord("¡Hola!"), "hola");
  EXPECT_EQ(Dictionary::cleanWord("„Wort“"), "wort");
  EXPECT_EQ(Dictionary::cleanWord("‹word›"), "word");
  EXPECT_EQ(Dictionary::cleanWord("word¹"), "word");
  EXPECT_EQ(Dictionary::cleanWord("\xC2\xA0word\xC2\xA0"), "word");  // no-break spaces
  EXPECT_EQ(Dictionary::cleanWord("\xEF\xBB\xBFword"), "word");      // zero-width no-break space
  EXPECT_EQ(Dictionary::cleanWord("（привет），"), "привет");
  EXPECT_EQ(Dictionary::cleanWord("「言葉」。"), "言葉");
  EXPECT_EQ(Dictionary::cleanWord("《书》"), "书");
  EXPECT_EQ(Dictionary::cleanWord("«»"), "");

  // Letters among those code blocks, and marks inside a word, stay.
  EXPECT_EQ(Dictionary::cleanWord("nº"), "nº");
  EXPECT_EQ(Dictionary::cleanWord("µm"), "µm");
  EXPECT_EQ(Dictionary::cleanWord("rock’n’roll"), "rock’n’roll");
  EXPECT_EQ(Dictionary::cleanWord("々"), "々");  // ideographic iteration mark
}

TEST_F(DictionaryTest, GuillemetsDoNotHideAWord) {
  ASSERT_NO_FATAL_FAILURE(writeDictionary("Guillemets", {{"über", "over"}, {"qué", "what"}}));
  Dictionary dict;
  ASSERT_NO_FATAL_FAILURE(openIndexed(dict, "Guillemets"));
  expectHit(dict, "«Über»", "über", "over");
  expectHit(dict, "¿Qué?", "qué", "what");
}

}  // namespace
